#include "lcd.h"

/*******************************************************************************
* گ ˽ Ļ         : Lcd1602_Delay1ms
* گ˽٦Ŝ		   : ғʱگ˽ìғʱ1ms
* ˤ    ɫ         : c
* ˤ    Զ         : Ϟ
* ˵    Ļ         : كگ˽ˇ՚12MHZާֱЂì12ؖƵեƬܺքғʱc
*******************************************************************************/

void Lcd1602_Delay1ms(uint c)   //ϳӮ 0us
{
    uchar a,b;
	for (; c>0; c--)
	{
		 for (b=50;b>0;b--)
		 {
		  	for(a=1;a>0;a--);
		 }      
	}
    	
}

void LcdWriteCom(uchar com)	  //дɫļ®
{
	LCD1602_E = 0;     //ʹŜ
	LCD1602_RS = 0;	   //ѡձע̍ļ®
	LCD1602_RW = 0;	   //ѡձдɫ
	
	LCD1602_DATAPINS = com;     //؅ɫļ®
	Lcd1602_Delay1ms(1);		//ֈս˽ߝψ֨

	LCD1602_E = 1;	          //дɫʱѲ
	Lcd1602_Delay1ms(5);	  //ѣԖʱݤ
	LCD1602_E = 0;
}

/*******************************************************************************
* گ ˽ Ļ         : LcdWriteData
* گ˽٦Ŝ		   : вLCDдɫһٶؖޚք˽ߝ
* ˤ    ɫ         : dat
* ˤ    Զ         : Ϟ
*******************************************************************************/		   
  
void LcdWriteData(uchar dat)			//дɫ˽ߝ
{
	LCD1602_E = 0;	//ʹŜȥ£
	LCD1602_RS = 1;	//ѡձˤɫ˽ߝ
	LCD1602_RW = 0;	//ѡձдɫ

	LCD1602_DATAPINS = dat; //дɫ˽ߝ
	Lcd1602_Delay1ms(1);

	LCD1602_E = 1;   //дɫʱѲ
	Lcd1602_Delay1ms(5);   //ѣԖʱݤ
	LCD1602_E = 0;
}

/*******************************************************************************
* گ ˽ Ļ       : LcdInit()
* گ˽٦Ŝ		 : ԵʼۯLCDǁ
* ˤ    ɫ       : Ϟ
* ˤ    Զ       : Ϟ
*******************************************************************************/		   

void LcdInit()						  //LCDԵʼۯؓԌѲ
{
 	LcdWriteCom(0x38);  //ߪДʾ
	LcdWriteCom(0x0c);  //ߪДʾһДʾڢҪ
	LcdWriteCom(0x06);  //дһٶָ֫ݓ1
	LcdWriteCom(0x01);  //ȥǁ
	LcdWriteCom(0x80);  //ʨ׃˽ߝָ֫ǰ֣
}

